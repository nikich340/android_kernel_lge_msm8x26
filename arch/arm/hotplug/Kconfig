## arch/arm/hotplug/Kconfig
```kconfig
config INTELLI_PLUG
        bool "Enable intelli-plug cpu hotplug driver"
        default n
        help
          Generic Intelli-plug cpu hotplug driver for ARM SOCs

config ALUCARD_HOTPLUG
        bool "Enable alucard cpu hotplug driver"
        default n
        help
          Generic alucard_hotplug cpu hotplug driver for ARM SOCs
```

## drivers/gpu/ion/Kconfig
```kconfig
menuconfig ION
	tristate "Ion Memory Manager"
	select GENERIC_ALLOCATOR
	select DMA_SHARED_BUFFER
	help
	  Chose this option to enable the ION Memory Manager.

config ION_TEGRA
	tristate "Ion for Tegra"
	depends on ARCH_TEGRA && ION
	help
	  Choose this option if you wish to use ion on an nVidia Tegra.

config ION_MSM
	tristate "Ion for MSM"
	depends on ARCH_MSM && ION
	help
	  Choose this option if you wish to use ion on an MSM target.

config ALLOC_BUFFERS_IN_4K_CHUNKS
	bool "Turns off allocation optimization and allocate only 4K pages"
	depends on ARCH_MSM && ION
	default n
	help
          Choose this option if you want ION to allocate buffers in
          only 4KB chunks.
```
